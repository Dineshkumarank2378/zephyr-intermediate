## CMakeLists.txt
```
cmake_minimum_required(VERSION 3.20.0)

find_package(Zephyr REQUIRED HINTS $ENV{ZEPHYR_BASE})

project(temp_alarm_test)

target_include_directories(app PRIVATE
    include
)

target_sources(app PRIVATE
    src/main.c
    src/temp_alarm.c
    src/sensor_fake.c
    src/test_temp_alarm.c
)
```

## prj.conf
```kconfig
CONFIG_ZTEST=y
CONFIG_ZTEST_NEW_API=y

CONFIG_SENSOR=y

CONFIG_LOG=y
CONFIG_LOG_DEFAULT_LEVEL=3

CONFIG_FFF=y

CONFIG_ASSERT=y
```

## src/main.c
```c
#include <zephyr/ztest.h>

void main(void)
{
    /* Ztest automatically executes the test suite. */
}
```

## include/sensor_fake.h
```c
#ifndef SENSOR_FAKE_H
#define SENSOR_FAKE_H

#include <zephyr/device.h>
#include <zephyr/drivers/sensor.h>

#include <zephyr/fff.h>

DECLARE_FAKE_VALUE_FUNC(
    int,
    fake_sensor_sample_fetch,
    const struct device *,
    enum sensor_channel
);

DECLARE_FAKE_VALUE_FUNC(
    int,
    fake_sensor_channel_get,
    const struct device *,
    enum sensor_channel,
    struct sensor_value *
);

const struct device *sensor_fake_get_device(void);

void sensor_fake_reset(void);

#endif
```

## include/temp_alarm.h
```c
#ifndef TEMP_ALARM_H
#define TEMP_ALARM_H

#include <zephyr/device.h>
#include <stdbool.h>

#define TEMP_ALARM_THRESHOLD_C 30.0

int temp_alarm_init(const struct device *sensor);

int temp_alarm_check(void);

bool temp_alarm_is_active(void);

void temp_alarm_reset(void);

#endif
```

## src/sensor_fake.c
```c
#include "sensor_fake.h"

#include <zephyr/logging/log.h>

LOG_MODULE_REGISTER(sensor_fake, LOG_LEVEL_INF);

DEFINE_FFF_GLOBALS;

DEFINE_FAKE_VALUE_FUNC(
    int,
    fake_sensor_sample_fetch,
    const struct device *,
    enum sensor_channel
);

DEFINE_FAKE_VALUE_FUNC(
    int,
    fake_sensor_channel_get,
    const struct device *,
    enum sensor_channel,
    struct sensor_value *
);

/*
 * Connect FFF fake functions to the Zephyr sensor API.
 */

static const struct sensor_driver_api fake_sensor_api = {
    .sample_fetch = fake_sensor_sample_fetch,
    .channel_get = fake_sensor_channel_get,
};

/*
 * Zephyr initializes this device during boot.
 */

static int fake_sensor_init(const struct device *dev)
{
    ARG_UNUSED(dev);

    return 0;
}

DEVICE_DEFINE(
    fake_sensor,
    "FAKE_SENSOR",
    fake_sensor_init,
    NULL,
    NULL,
    NULL,
    POST_KERNEL,
    CONFIG_KERNEL_INIT_PRIORITY_DEFAULT,
    &fake_sensor_api
);

const struct device *sensor_fake_get_device(void)
{
    return DEVICE_GET(fake_sensor);
}

void sensor_fake_reset(void)
{
    RESET_FAKE(fake_sensor_sample_fetch);
    RESET_FAKE(fake_sensor_channel_get);

    FFF_RESET_HISTORY();
}
```

## src/temp_alarm.c
```c
#include "temp_alarm.h"

#include <zephyr/drivers/sensor.h>
#include <zephyr/logging/log.h>

LOG_MODULE_REGISTER(temp_alarm, LOG_LEVEL_INF);

static const struct device *sensor_dev;

static bool alarm_active;

int temp_alarm_init(const struct device *sensor)
{
    if (sensor == NULL) {
        return -EINVAL;
    }

    if (!device_is_ready(sensor)) {
        return -ENODEV;
    }

    sensor_dev = sensor;
    alarm_active = false;

    LOG_INF("Temperature alarm initialized");

    return 0;
}

int temp_alarm_check(void)
{
    struct sensor_value temperature;
    double temperature_c;
    int ret;

    if (sensor_dev == NULL) {
        return -EINVAL;
    }

    /* Fetch a new sensor sample */
    ret = sensor_sample_fetch_chan(sensor_dev,
                                   SENSOR_CHAN_AMBIENT_TEMP);

    if (ret != 0) {
        LOG_ERR("Sensor fetch failed: %d", ret);

        return ret;
    }

    /* Read the fetched temperature */
    ret = sensor_channel_get(sensor_dev,
                             SENSOR_CHAN_AMBIENT_TEMP,
                             &temperature);

    if (ret != 0) {
        LOG_ERR("Temperature read failed: %d", ret);

        return ret;
    }

    temperature_c = sensor_value_to_double(&temperature);

    LOG_INF("Temperature: %.2f C", temperature_c);

    if (temperature_c > TEMP_ALARM_THRESHOLD_C) {
        alarm_active = true;

        LOG_WRN("Temperature alarm activated!");
    } else {
        alarm_active = false;

        LOG_INF("Temperature is normal");
    }

    return 0;
}

bool temp_alarm_is_active(void)
{
    return alarm_active;
}

void temp_alarm_reset(void)
{
    alarm_active = false;

    LOG_INF("Temperature alarm reset");
}
```

## src/test_temp_alarm.c
```c
#include <zephyr/ztest.h>
#include <zephyr/drivers/sensor.h>
#include <zephyr/fff.h>

#include "temp_alarm.h"
#include "sensor_fake.h"

static struct sensor_value fake_temperature;

/*
 * Fake sensor returns the configured temperature.
 */

static int fake_get_temperature(
    const struct device *dev,
    enum sensor_channel channel,
    struct sensor_value *value)
{
    ARG_UNUSED(dev);

    if (channel != SENSOR_CHAN_AMBIENT_TEMP) {
        return -EINVAL;
    }

    *value = fake_temperature;

    return 0;
}

/*
 * Runs before every test.
 */

static void before_test(void)
{
    sensor_fake_reset();

    fake_temperature.val1 = 25;
    fake_temperature.val2 = 0;

    fake_sensor_sample_fetch.return_val = 0;

    fake_sensor_channel_get.custom_fake =
        fake_get_temperature;

    temp_alarm_reset();

    zassert_ok(
        temp_alarm_init(sensor_fake_get_device()),
        "Temperature alarm initialization failed"
    );
}

ZTEST_SUITE(
    temp_alarm,
    NULL,
    NULL,
    before_test,
    NULL,
    NULL
);

/*
 * TASK 1: Temperature below threshold
 */

ZTEST(temp_alarm, test_temperature_below_threshold)
{
    fake_temperature.val1 = 20;
    fake_temperature.val2 = 0;

    int ret = temp_alarm_check();

    zassert_equal(ret, 0,
                  "Temperature check should succeed");

    zassert_false(temp_alarm_is_active(),
                  "Alarm must remain inactive");

    zassert_equal(fake_sensor_sample_fetch.call_count, 1,
                  "Sensor must be fetched once");

    zassert_equal(fake_sensor_channel_get.call_count, 1,
                  "Temperature must be read once");
}

/*
 * TASK 1: Temperature above threshold
 */

ZTEST(temp_alarm, test_temperature_above_threshold)
{
    fake_temperature.val1 = 35;
    fake_temperature.val2 = 0;

    int ret = temp_alarm_check();

    zassert_equal(ret, 0,
                  "Temperature check should succeed");

    zassert_true(temp_alarm_is_active(),
                 "Alarm must activate above threshold");

    zassert_equal(fake_sensor_sample_fetch.call_count, 1,
                  "Sensor must be fetched once");

    zassert_equal(fake_sensor_channel_get.call_count, 1,
                  "Temperature must be read once");
}

/*
 * TASK 1: Reset clears the alarm
 */

ZTEST(temp_alarm, test_alarm_reset)
{
    fake_temperature.val1 = 40;

    zassert_ok(temp_alarm_check());

    zassert_true(temp_alarm_is_active(),
                 "Alarm should be active");

    temp_alarm_reset();

    zassert_false(temp_alarm_is_active(),
                  "Reset must clear alarm state");
}

/*
 * TASK 2: Fetch failure propagates
 */

ZTEST(temp_alarm, test_sensor_fetch_failure)
{
    fake_sensor_sample_fetch.return_val = -EIO;

    int ret = temp_alarm_check();

    zassert_equal(ret, -EIO,
                  "Fetch error must propagate");

    zassert_equal(fake_sensor_sample_fetch.call_count, 1,
                  "Fetch must be called");

    zassert_equal(fake_sensor_channel_get.call_count, 0,
                  "Channel get must not happen after fetch failure");

    zassert_false(temp_alarm_is_active(),
                  "Alarm should remain inactive");
}

/*
 * TASK 2: Channel read failure propagates
 */

ZTEST(temp_alarm, test_channel_get_failure)
{
    fake_sensor_channel_get.return_val = -EIO;

    int ret = temp_alarm_check();

    zassert_equal(ret, -EIO,
                  "Channel get error must propagate");

    zassert_equal(fake_sensor_sample_fetch.call_count, 1,
                  "Fetch must be called");

    zassert_equal(fake_sensor_channel_get.call_count, 1,
                  "Channel get must be called");
}

/*
 * TASK 2: Fail and then recover
 */

ZTEST(temp_alarm, test_fail_then_recover)
{
    /*
     * First operation fails.
     */

    fake_sensor_sample_fetch.return_val = -EIO;

    int ret = temp_alarm_check();

    zassert_equal(ret, -EIO,
                  "First operation must fail");

    zassert_false(temp_alarm_is_active(),
                  "Alarm must not activate after failure");

    /*
     * Simulate recovery.
     */

    fake_sensor_sample_fetch.return_val = 0;

    fake_temperature.val1 = 35;
    fake_temperature.val2 = 0;

    ret = temp_alarm_check();

    zassert_equal(ret, 0,
                  "Second operation should succeed");

    zassert_true(temp_alarm_is_active(),
                 "Alarm must activate after recovery");

    zassert_equal(fake_sensor_sample_fetch.call_count, 2,
                  "Fetch should have been called twice");

    zassert_equal(fake_sensor_channel_get.call_count, 1,
                  "Channel get should only occur on successful fetch");
}

/*
 * Test NULL sensor
 */

ZTEST(temp_alarm, test_null_sensor)
{
    temp_alarm_reset();

    int ret = temp_alarm_init(NULL);

    zassert_equal(ret, -EINVAL,
                  "NULL sensor must return -EINVAL");
}
```
